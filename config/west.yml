## config/west.yml
```yaml
manifest:
  remotes:
    - name: zmkfirmware
      url-base: https://github.com/zmkfirmware
  projects:
    - name: zmk
      remote: zmkfirmware
      revision: 8f5c7bbfd471d6720410980d6d905673411c363c
      import: app/west.yml
  self:
    path: config
```
